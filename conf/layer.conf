## conf/layer.conf
```bitbake
# It really depends on order of the layers appearing in BBLAYERS
# variable in toplevel bblayers.conf file, where bitbake will search
# for .inc files and others where bitbake uses BBPATH since it will
# search the directories from first to last as specified in BBPATH
# Therefore if you want a given layer to be considered high priority
# for the .inc and .conf etc. then consider it adding at the beginning
# of BBPATH. For bblayers bitbake will use BBFILES_PRIORITY to resolve
# the recipe contention so the order of directories in BBFILES does 
# not matter.

# We have a conf and classes directory, append to BBPATH
BBPATH .= ":${LAYERDIR}"

# We have a recipes directory, add to BBFILES
BBFILES += "${LAYERDIR}/recipes-*/*/*.bb ${LAYERDIR}/recipes-*/*/*.bbappend"

BBFILE_COLLECTIONS += "openxt-optional-layer"
BBFILE_PATTERN_openxt-optional-layer := "^${LAYERDIR}/"

# Define the priority for recipes (.bb files) from this layer,
# choosing carefully how this layer interacts with all of the
# other layers.

BBFILE_PRIORITY_openxt-optional-layer = "12"

# This should only be incremented on significant changes that will
# cause compatibility issues with other layers
LAYERVERSION_openxt-optional-layer = "1"

#LAYERDEPENDS_openxt-optional-layer = "xenclient-oe"

LICENSE_PATH += "${LAYERDIR}/licenses"

PREFERRED_PROVIDER_dbd = "qtdbd"
PREFERRED_PROVIDER_db-tools = "qtdbd-tools"
```
